AUTOSAR XML (schema 4-2-2)
package /RootP_Composition
  composition sw component type Compo_VSM
    connect Instance_ASWC_M743.PP_CS_EtatBDEtest -> Instance_ASWC_M740.RP_CS_EtatBDE
    connect Instance_ASWC_M743.PP_CS_EtatBDEtest -> Instance_ASWC_M741.RP_CS_EtatBDEtest
