AUTOSAR XML (schema 4-2-2)
package /RootP_Composition
  composition sw component type Compo_VSM
    connect Instance_ASWC_M6.PP_CS_VehicleSPeed -> Instance_ASWC_M740.RP_CS_VehicleSPeed
    connect Instance_ASWC_M6.PP_CS_VehicleSPeed -> Instance_ASWC_M740.RP_CS_VehicleSPeed
