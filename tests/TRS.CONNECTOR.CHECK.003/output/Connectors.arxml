AUTOSAR XML (schema 4-2-2)
package /RootP_Composition
  composition sw component type Compo_VSM
    connect Instance_ASWC_M743.MPRP_CS_EtatBDEtest -> Instance_ASWC_M740.RP_CS_EtatBDE
