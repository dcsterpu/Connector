AUTOSAR XML (schema 4-2-2)
package /RootP_Composition
  composition sw component type Compo_VSM
    connect Instance_ASWC_A7G.PP_SR_HoldCluster -> Instance_ASWC_LPhM.RP_HoldBODY_{3..7}
    connect Instance_ASWC_A7G.PP_SR_HoldCluster -> Instance_ASWC_LPhM.RP_HoldBODY_9
    connect Instance_ASWC_A7G.PP_SR_HoldCluster -> Instance_ASWC_LPhM.RP_HoldInternal
    connect Instance_ASWC_A7G.PP_SR_HoldCluster -> Instance_ASWC_LPhM.RP_HoldLin_{1..8}
    connect Instance_ASWC_A7G.PP_SR_HoldCluster -> Instance_ASWC_LPhM.RP_HoldPWT1
    connect Instance_ASWC_A7G.PP_SR_HoldCluster -> Instance_ASWC_LPhM.RP_HoldPWT2
    connect Instance_ASWC_A7G.PP_SR_HoldCluster -> Instance_ASWC_LPhM.RP_HoldPWT8
    connect Instance_ASWC_A7G.PP_SR_HoldCluster -> Instance_ASWC_LPhM.RP_SR_HoldCluster
