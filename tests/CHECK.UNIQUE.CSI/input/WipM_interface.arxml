AUTOSAR XML (schema 4-0-3)
package /Pack_sw_Types
  impl type Wiper_DriveModeType: category=VALUE, base-type=uint8, range raw 0..255
package /RootP_CS
  client server interface CS_WiperR_Drive
    operation OP_SET
      arg DriveMode: type=Wiper_DriveModeType, direction=IN
  client server interface CS_WiperF_Drive
    operation OP_SET
      arg DriveMode: type=Wiper_DriveModeType, direction=IN
