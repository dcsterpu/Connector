AUTOSAR XML (schema 4-2-2)
package /RootP_Composition
  composition sw component type Compo_VSM
    connect Instance_ASWC_SATELLITE_CORE1_AppASILA.PP_CS_NVDM_WR_APP -> Instance_ASWC_M302.RP_CS_NVDM_WR_APP
    connect Instance_ASWC_SATELLITE_CORE1_AppASILA.PP_CS_Resources -> Instance_ASWC_M302.RP_CS_Resources
    connect Instance_ASWC_SATELLITE_CORE1_AppASILA.PP_CS_VoyantService -> Instance_ASWC_M302.RP_CS_VoyantService
    connect Instance_ASWC_SATELLITE_CORE1_AppASILA.PP_CS_WiperF_Drive -> Instance_ASWC_M302.RP_CS_WiperF_Drive
    connect Instance_ASWC_SATELLITE_CORE1_AppASILA.PP_CS_WiperR_Drive -> Instance_ASWC_M302.RP_CS_WiperR_Drive
    connect Instance_WipM.PP_WiperR_Drive -> Instance_ASWC_DISPATCH_CORE0_SWPQM.RP_CS_WiperR_Drive
    connect Instance_WipM.PP_WiperF_Drive -> Instance_ASWC_DISPATCH_CORE0_SWPQM.RP_CS_WiperF_Drive
