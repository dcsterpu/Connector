AUTOSAR XML (schema 4-2-1)
package /RootP_ASWC_M740
  application sw component type ASWC_M740
    require port RP_CS_EtatBoutonFSE: required-interface=CS_EtatBoutonFSE
package /RootP_Composition
  composition sw component type Compo_VSM
    component Instance_ASWC_M740: type=ASWC_M740
