AUTOSAR XML (schema 4-2-1)
package /RootP_ASWC_M6
  application sw component type ASWC_M6
    provide port PP_CS_VehicleSPeed: provided-interface=CS_VehicleSPeed
    provide/require port PRP_CS_VehicleSPeed: provided-required-interface=CS_VehicleSPeed
package /RootP_Composition
  composition sw component type Compo_VSM
    component Instance_ASWC_M6: type=ASWC_M6
