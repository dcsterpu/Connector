AUTOSAR XML (schema 4-2-2)
package /RootP_Composition
  composition sw component type Compo_VSM
    connect Inst_BswM.BswM_ModeSwitchPort_OsApp_AppSwitchLocalPort_Switch_Rte_CORE0_PARTITION0 -> Instance_ASWC_M740.ASWC_M740_MSI
