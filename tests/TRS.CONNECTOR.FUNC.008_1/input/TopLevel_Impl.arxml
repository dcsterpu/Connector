AUTOSAR XML (schema 4-3-0)
package /RootP_Composition
  composition sw component type Compo_VSM
    5 x component:
      Inst_BswM: type=BswM_OsApp_CORE0_PARTITION0
      Instance_ASWC_M740: type=ASWC_M740
      Instance_ASWC_M741: type=ASWC_M741
      Inst_BswM2: type=BswM_OsApp_CORE1_PARTITION0
      Inst_bla-bla: type=Aswc_IntDcm
    connect SWC_CyclicCounter.P_EchoCalc -> SWC_ModifyEcho.R_EchoResult
    connect SWC_ModifyEcho.P_SpecialRequest -> SWC_CyclicCounter.R_SpecialHandling
    connect SWC_IoHwAbs.P_MyLED -> SWC_CyclicCounter.R_MyLED
