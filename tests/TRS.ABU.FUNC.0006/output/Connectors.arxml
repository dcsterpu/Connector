AUTOSAR XML (schema 4-2-2)
package /RootP_Composition
  composition sw component type Compo_VSM
    connect Instance_ASWC_M741.PP_CS_VehicleSpeed -> Instance_ASWC_M740.RP_CS_VehicleSpeed
    connect Instance_ASWC_M741.PP_CS_VehicleSpeed -> Instance_ASWC_M742.RP_CS_VehicleSpeed
