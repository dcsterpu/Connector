AUTOSAR XML (schema 4-2-1)
package /RootP_ASWC_M742
  application sw component type ASWC_M742
    require port RP_CS_VehicleSpeed: required-interface=CS_VehicleSpeed
package /RootP_Composition
  composition sw component type Compo_VSM
    component Instance_ASWC_M742: type=ASWC_M742
