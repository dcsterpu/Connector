AUTOSAR XML (schema 4-2-2)
package /RootP_Composition
  composition sw component type Compo_VSM
    connect Instance_ASWC_M741.PP_SR_ControlState -> Instance_ASWC_M740.RP_NV_ControlState
    connect Instance_ASWC_M741.PP_NV_ControlState -> Instance_ASWC_M740.RP_SR_ControlState
