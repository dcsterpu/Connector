AUTOSAR XML (schema 4-2-2)
package /RootP_Composition
  composition sw component type Compo_VSM
    connect Instance_ASWC_M741.SR_VehicleSPeed -> Instance_ASWC_M740.SR_VehicleSPeed
    connect Instance_ASWC_M741.SR_VehicleSPeed -> Instance_ASWC_M740.123_SR_VehicleSPeed
