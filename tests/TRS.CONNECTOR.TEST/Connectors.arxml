AUTOSAR XML (schema 4-2-2)
package /RootP_Composition
  composition sw component type Compo_VSM
    connect Instance_ASWC_M741.PP_SR_VehicleSPeed -> Instance_ASWC_M740.RP_SR_VehicleSPeed
    connect Instance_ASWC_M741.PP_SR_VehicleSPeed -> Instance_ASWC_M740.123_SR_VehicleSPeed
