AUTOSAR XML (schema 4-2-2)
package /RootP_Composition
  composition sw component type Compo_VSM
    connect Instance_ASWC_M6.PP_CS_VehicleSpeed -> Instance_ASWC_M740.RPort_abc
