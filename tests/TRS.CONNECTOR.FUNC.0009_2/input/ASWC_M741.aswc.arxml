AUTOSAR XML (schema 4-2-1)
package /RootP_ASWC_M741
  application sw component type AswcDiagForDcm
    provide port PP_CS_VehicleSpeed: provided-interface=CS_VehicleSpeed
package /RootP_Composition
  composition sw component type Compo_VSM
    component Instance_AswcDiagForDcm: type=AswcDiagForDcm
