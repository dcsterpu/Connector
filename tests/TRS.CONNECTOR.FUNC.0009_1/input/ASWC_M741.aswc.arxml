AUTOSAR XML (schema 4-2-1)
package /RootP_ASWC_M741
  application sw component type ASWC_M741
    provide port PP_CS_VehicleSpeed: provided-interface=CS_VehicleSpeed
package /RootP_Composition
  composition sw component type Compo_VSM
    component Instance_ASWC_M741: type=ASWC_M741
