AUTOSAR XML (schema 4-2-2)
package /RootP_Composition
  composition sw component type Compo_VSM
    connect Instance_ASWC_SATELLITE_CORE0_SWPQM.PP_CS_NVDM_WR_APP -> Instance_Dcm.RP_CS_NVDM_WR_APP
    connect Instance_BSWC_NvDM_Satellite_CORE0_SWPQM.PP_CS_NVDM_WR_APP -> Instance_Dcm.RP_CS_NVDM_WR_APP
