AUTOSAR XML (schema 4-2-1)
package /Dcm
  application sw component type Dcm
    require port RP_CS_NVDM_WR_APP: required-interface=CS_NVDM_WR_APP
package /RootP_Composition
  composition sw component type Compo_VSM
    component Instance_Dcm: type=Dcm
