AUTOSAR XML (schema 4-2-1)
package /RootP_IntDcm
  application sw component type Aswc_IntDcm
    provide/require port PRP_CS_VitesseVehicule: provided-required-interface=CS_VitesseVehicule
package /RootP_Composition
  composition sw component type Compo_VSM
    component Instance_ASWC_M741: type=ASWC_M741
