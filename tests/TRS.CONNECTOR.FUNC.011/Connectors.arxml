AUTOSAR XML (schema 4-2-2)
package /RootP_Composition
  composition sw component type Compo_VSM
    connect .Test_OsApp_CORE1_PARTITION0_bla_bla -> Instance_ASWC_M740.ASWC_M740_MSI
