AUTOSAR XML (schema 4-2-2)
package /RootP_Composition
  composition sw component type Compo_VSM
    connect .BswM_ModeSwitchPort_OsApp_CORE1_PARTITION0_BswMSwitchLocalPort_SlaveCore_Rte -> Instance_ASWC_M740.ASWC_M740_MSI
