AUTOSAR XML (schema 4-3-0)
package /RootP_Composition
  composition sw component type Compo_VSM
    6 x component:
      Inst_BswM: type=BswM_OS_APP_CORE1_QM
      Instance_ASWC_M740: type=ASWC_M740
      Instance_ASWC_M741: type=ASWC_M741
      Inst_BswM2: type=BswM_OS_APP_APP_1_QM
      Inst_bla: type=AswcDiagForDcm
      Instance_Aswc_IntDcm: type=Aswc_IntDcm
    connect SWC_CyclicCounter.P_EchoCalc -> SWC_ModifyEcho.R_EchoResult
    connect SWC_ModifyEcho.P_SpecialRequest -> SWC_CyclicCounter.R_SpecialHandling
    connect SWC_IoHwAbs.P_MyLED -> SWC_CyclicCounter.R_MyLED
