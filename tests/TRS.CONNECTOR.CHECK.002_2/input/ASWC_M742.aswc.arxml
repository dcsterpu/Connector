AUTOSAR XML (schema 4-2-1)
package /RootP_ASWC_M742
  application sw component type ASWC_M742
    provide/require port PRP_CS_VehicleSPeed: provided-required-interface=CS_VehicleSPeed
  application sw component type ASWC_M743
    provide/require port PRP_CS_VehicleSPeed: provided-required-interface=CS_VehicleSPeed
package /RootP_Composition
  composition sw component type Compo_VSM
    component Instance_ASWC_M742: type=ASWC_M742
  composition sw component type Compo_VSM
    component Instance_ASWC_M743: type=ASWC_M743
