AUTOSAR XML (schema 4-2-2)
package /RootP_Composition
  composition sw component type Compo_VSM
    connect Inst_bla.PRP_CS_EtatBDE -> Instance_ASWC_M740.RP_CS_EtatBDE
