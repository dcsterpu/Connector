AUTOSAR XML (schema 4-2-1)
package /RootP_IntDcm
  application sw component type AswcDiagForDcm
    provide/require port PRP_CS_EtatBDE: provided-required-interface=CS_EtatBDE
package /RootP_Composition
  composition sw component type Compo_VSM
    component Instance_ASWC_M741: type=ASWC_M741
