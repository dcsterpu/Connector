AUTOSAR XML (schema 4-2-2)
package /RootP_Composition
  composition sw component type Compo_VSM
    connect Inst_bla-bla.PP_ParamStruct -> Instance_ASWC_M740.RP_ParamStruct
    connect Inst_bla-bla.PRP_SR_VitesseVehicule -> Instance_ASWC_M740.RP_SR_VitesseVehicule
    connect Inst_bla-bla.PP_SR_VitesseVehiculeCorrompue -> Instance_ASWC_M740.RP_SR_VitesseVehiculeCorrompue
