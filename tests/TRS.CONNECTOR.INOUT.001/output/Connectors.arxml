AUTOSAR XML (schema 4-2-2)
package /RootP_Composition
  composition sw component type Compo_VSM
    connect Inst_bla-bla.PP_SR_VitesseVehiculeCorrompue -> Instance_ASWC_M740.Rp_NvDMData1
    connect Inst_bla-bla.Pp_NvDMData1 -> Instance_ASWC_M740.RP_SR_VitesseVehiculeCorrompue
    connect Inst_bla-bla.PRP_SR_VitesseVehicule -> Instance_ASWC_M740.RP_SR_VitesseVehicule
    connect Inst_bla-bla.PRP_SR_VitesseVehicule -> Instance_ASWC_M740.RP_SR_VitesseVehicule
    connect Inst_BswM2.BswM_ModeSwitchPort_OS_APP_APP_1_QM_AppSwitchLocalPort_Rte -> Instance_ASWC_M740.ASWC_M740_MSI
    connect Inst_bla-bla.PP_ParamStruct -> Instance_ASWC_M740.RP_ParamStruct
