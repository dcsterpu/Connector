AUTOSAR XML (schema 4-2-1)
package /RootP_ASWC_N742
  application sw component type ASWC_N742
    provide/require port PRP_NV_VehicleData: provided-required-interface=NV_VehicleData
package /RootP_Composition
  composition sw component type Compo_VSM
    component Instance_ASWC_M742: type=ASWC_N742
