AUTOSAR XML (schema 4-2-1)
package /RootP_IntDcm
  application sw component type Aswc_IntDcm
    provide/require port PRP_CS_VehicleData: provided-required-interface=CS_VehicleData
package /RootP_Composition
  composition sw component type Compo_VSM
    component Instance_ASWC_M742: type=ASWC_M742
